static const unsigned char PROGMEM str1[]
{

0xEF,0xFE,0xEF,0xFE,0xEF,0xFE,0x77,0x80,0x77,0xBF,0xB3,0xDF,0xD3,0xFB,0xF5,0xFB,
0x76,0xEB,0x77,0xDB,0xB7,0xDB,0xB7,0xBB,0xD7,0xBB,0xF7,0xFB,0xF7,0xFA,0xF7,0xFD,//你0
};
static const unsigned char PROGMEM str2[]
{
0x6F,0xFF,0xEF,0xFE,0xEF,0xC2,0xB7,0xDF,0xB7,0xDF,0xB3,0xDF,0xB3,0xDF,0xB5,0xDF,
0xB6,0xDF,0xB7,0xDF,0xB7,0xDF,0xB7,0xDF,0xB7,0xDF,0xB7,0xDF,0xB7,0xD7,0xB7,0xEF,//们1
};
static const unsigned char PROGMEM str3[]
 {
0x7F,0xFF,0x7F,0xFF,0x7F,0xFF,0x7F,0xFF,0x7F,0xFF,0x00,0x80,0x7F,0xFF,0x7F,0xFF,
0xBF,0xFE,0xBF,0xFE,0xDF,0xFD,0xDF,0xFD,0xAF,0xFB,0x77,0xF7,0x7B,0xEF,0xFC,0x9F,//太2
};
static const unsigned char PROGMEM str4[]
  {
0xFF,0xFD,0xFF,0xFD,0xE1,0xFD,0x6D,0xED,0x6D,0xDD,0xAD,0xBD,0xAD,0xBD,0xCD,0xED,
0xED,0xED,0xED,0xED,0xE1,0xF7,0xED,0xF7,0xFF,0xFB,0xFF,0xFD,0x7F,0xFE,0x9F,0xFF,//吵3
};
static const unsigned char PROGMEM str5[]
{
0xFF,0xFF,0x01,0xE0,0xFF,0xF7,0xFF,0xFB,0xFF,0xFD,0x7F,0xFE,0x7F,0xFF,0x7F,0xFF,
0x7F,0xFF,0x7F,0xFF,0x7F,0xFF,0x7F,0xFF,0x7F,0xFF,0x7F,0xFF,0x5F,0xFF,0xBF,0xFF,//了4

};
/**********************************字模点阵
/************led******************/
#include <Adafruit_NeoPixel.h>//引用头文件

#include <SoftwareSerial.h>
#include <IRremote.h>
int RECV_PIN = 12;   //红外线接收器OUTPUT端接在pin 12
IRrecv irrecv(RECV_PIN);  //定义IRrecv对象来接收红外线信号
decode_results results;   //解码结果放在decode_results构造的对象results里
#include <Microduino_Tem_Hum.h>
#include <Wire.h>
#include "Rtc_Pcf8563.h"
#include <U8glib.h>
#define INTERVAL_LCD 20 //定义OLED刷新时间间隔 
unsigned long lcd_time = millis(); //OLED刷新时间计时器
U8GLIB_SSD1306_128X64 u8g(U8G_I2C_OPT_NONE); //设置OLED型号 
//-------字体设置，大、中、小
#define setFont_H u8g.setFont(u8g_font_timB18)
#define setFont_M u8g.setFont(u8g_font_timB10)
Rtc_Pcf8563 rtc;//定义rtc
#define crash 10//按键的引脚
#define buzzer_pin 8 //定义蜂鸣器驱动引脚
#define buzzer_fre 600 //定义蜂鸣器输出频率
int buttonState;
void setup() {
Wire.begin();
Serial.begin(9600);  
pinMode(crash,INPUT);
pinMode(buzzer_pin, OUTPUT);
settime(17,12,21,4,15,14,57);
irrecv.enableIRIn(); 
 
}


void loop() {

 coutOLED();//输出到OLED
 
if(rtc.getHour()==15&&rtc.getMinute()==15&&rtc.getSecond()==5)//设置响铃时间
{
  tone(buzzer_pin, buzzer_fre);   //驱动蜂鸣器
    delay(100);}
    if(!digitalRead(crash))  
  { noTone(buzzer_pin);//蜂鸣器不响
    }
}

void settime(int _year, int _month, int _day, int _week, int _hour, int _min, int _sec)
{
  //clear out the registers
  rtc.initClock();
  //set a time to start with.
  //day, weekday, month, century(1=1900, 0=2000), year(0-99)
  rtc.setDate(_day, _week, _month, 0, _year);
  //hr, min, sec
  rtc.setTime(_hour, _min, _sec);
}

void coutOLED()
{
   u8g.firstPage();
 do {
 setFont_M;
 u8g.setPrintPos(3, 10);
 u8g.print("Date:");
u8g.print(rtc.formatDate());//打印日期
 setFont_H;
u8g.setPrintPos(20, 50);
 //u8g.print("Time:");
 u8g.print(rtc.formatTime());//打印时间
 
  }while( u8g.nextPage() );

 // delay();
}


